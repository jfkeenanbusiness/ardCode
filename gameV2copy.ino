#include <Wire.h>
#include <Adafruit_GFX.h>
#include <Adafruit_SSD1306.h>
#include "pitches.h"
#define SCREEN_WIDTH 128
#define SCREEN_HEIGHT 64
#define REST -1
Adafruit_SSD1306 display(SCREEN_WIDTH, SCREEN_HEIGHT, &Wire, -1);

int buttonPin = 8;
int mode = 1;
int score = 1;
int highscore = 1;
int pop = 0;
const int speakerPin = 7;
int melody[] = {
  NOTE_C4, NOTE_D4, NOTE_C4, NOTE_A3, NOTE_A3, NOTE_AS3, NOTE_A3, NOTE_G3, NOTE_A3, NOTE_AS3, NOTE_A3, NOTE_AS3, NOTE_F3, NOTE_C4, NOTE_A3, NOTE_F3, NOTE_D3, NOTE_G3, NOTE_C3, NOTE_G3, NOTE_D4, NOTE_C4, NOTE_AS3, NOTE_A3, NOTE_G3, NOTE_A3, NOTE_AS3, NOTE_A3, NOTE_E3, NOTE_A3, NOTE_A3, NOTE_GS3, NOTE_B3, NOTE_F4, NOTE_E4, NOTE_DS4, NOTE_E4, NOTE_G3, NOTE_A3, NOTE_AS3, REST, NOTE_A3, NOTE_F3, NOTE_D4, NOTE_C4, REST, NOTE_F3, NOTE_C3, NOTE_AS3, NOTE_A3, NOTE_G3, NOTE_F3, REST, NOTE_F4, REST
};
int noteDurations[] = {
  4, 3, 1, 4, 4, 1, 2, 1, 3, 1, 8, 4,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 4
};
unsigned long pauseBetweenNotes;
int thisNote;

unsigned long previousMillis = 0;
unsigned long musicPreviousMillis = 0;

void setup() {
  Serial.begin(115200);
  pinMode(buttonPin, INPUT_PULLUP);
  pinMode(speakerPin, OUTPUT);
  if (!display.begin(SSD1306_SWITCHCAPVCC, 0x3C)) {
    Serial.println(F("SSD1306 allocation failed"));
    for (;;)
      ;
  }
  display.clearDisplay();
  display.setTextSize(1);
  display.setTextColor(WHITE);
  previousMillis = millis();
}



void loop() {
  int buttonValue = digitalRead(buttonPin);

  if (mode == 1) {
    static const unsigned char PROGMEM image_data_Saraarray[] = {
      0xff, 0xff, 0xff, 0xff, 0xff, 0xff, 0xff, 0xff, 0xff, 0xff, 0xff, 0xff, 0xff, 0xff, 0xff, 0xff,
      0xff, 0xff, 0xff, 0xff, 0xff, 0xff, 0xff, 0xff, 0xff, 0xff, 0xff, 0xff, 0xff, 0xff, 0xff, 0xff,
      0xff, 0xff, 0xff, 0xff, 0xff, 0xff, 0xff, 0xff, 0xff, 0xff, 0xff, 0xff, 0xff, 0xff, 0xff, 0xff,
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      0x00, 0x00, 0x00, 0x00, 0x00, 0x00, 0x00, 0x00, 0x00, 0x00, 0x00, 0x00, 0x00, 0x00, 0x00, 0x00
    };
    display.drawBitmap(0, 0, image_data_Saraarray, 128, 64, 1);
    display.display();
    if (millis() - previousMillis >= 2000) {
      mode = 2;
      display.clearDisplay();
      previousMillis = millis();
    }
    if (millis() - previousMillis <= 1000) {
      tone(speakerPin, 523);
    }
    if (millis() - previousMillis <= 1500 && millis() - previousMillis >= 1000) {
      tone(speakerPin, 554);
    }
    if (millis() - previousMillis >= 1500) {
      tone(speakerPin, 622);
    }
  }

  if (mode == 2) {
    noTone(speakerPin);
    static const unsigned char PROGMEM image_data_Saraarray[] = {
      0xff, 0xff, 0xff, 0xff, 0xff, 0xff, 0xff, 0xff, 0xff, 0xff, 0xff, 0xff, 0xff, 0xff, 0xff, 0xff,
      0xff, 0xff, 0xff, 0xff, 0xff, 0xff, 0xff, 0xff, 0xff, 0xff, 0xff, 0xff, 0xff, 0xff, 0xff, 0xff,
      0xff, 0xff, 0xff, 0xff, 0xff, 0xff, 0xff, 0xff, 0xff, 0xff, 0xff, 0xff, 0xff, 0xff, 0xff, 0xff,
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      0x1b, 0xbb, 0x81, 0xe6, 0x06, 0x00, 0x5f, 0xe0, 0x4e, 0xd0, 0x00, 0x02, 0x36, 0x7b, 0x01, 0xf8
    };
    display.drawBitmap(0, 0, image_data_Saraarray, 128, 64, 1);
    display.setTextSize(1);
    display.setTextColor(WHITE);
    display.setCursor(34, 20);
    display.println("Press Light to");
    display.setCursor(34, 30);
    display.println("SURVIVE and ");
    display.setCursor(34, 40);
    display.println("avoid MONSTERS");
    display.display();

    if (buttonValue == 0 && millis() - previousMillis >= 500) {
      display.clearDisplay();
      pop = 0;
      mode = 3;
      previousMillis = millis();
      thisNote = 0;
    }
  }

  if (mode == 3) {
    display.clearDisplay();
    if (millis() - previousMillis >= 1200 - score * 100) {
      pop = random() % (4 + score);
      previousMillis = millis();
    }





    if (pop == 0) {}

    if (pop == 1) {
      static const unsigned char PROGMEM image_data_Saraarray[] = {
        0x00, 0x00, 0x00, 0x00, 0x00, 0x00, 0x00, 0x00, 0x00, 0x00, 0x00, 0x00, 0x00, 0x00, 0x00, 0x00,
        0x00, 0x00, 0x00, 0x00, 0x00, 0x00, 0x00, 0x00, 0x00, 0x00, 0x00, 0x00, 0x00, 0x00, 0x00, 0x00,
        0x00, 0x00, 0x00, 0x00, 0x00, 0x00, 0x00, 0x00, 0x00, 0x00, 0x00, 0x00, 0x00, 0x00, 0x00, 0x00,
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        0x00, 0x00, 0x00, 0x00, 0x00, 0x00, 0x00, 0x00, 0x00, 0x00, 0x00, 0x00, 0x00, 0x00, 0x00, 0x00
      };
      display.drawBitmap(0, 0, image_data_Saraarray, 128, 64, 1);
      if (buttonValue == 0) {
        display.clearDisplay();
        mode = 5;
        previousMillis = millis();
      }
    }









    if (pop == 2) {
      static const unsigned char PROGMEM image_data_Saraarray[] = {
        0x00, 0x00, 0x00, 0x00, 0x00, 0x00, 0x00, 0x00, 0x00, 0x00, 0x00, 0x00, 0x00, 0x00, 0x00, 0x00,
        0x00, 0x00, 0x00, 0x00, 0x00, 0x00, 0x00, 0x00, 0x00, 0x00, 0x00, 0x00, 0x00, 0x00, 0x00, 0x00,
        0x00, 0x00, 0x00, 0x00, 0x00, 0x00, 0x00, 0x00, 0x00, 0x00, 0x00, 0x00, 0x00, 0x00, 0x00, 0x00,
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        0x00, 0x00, 0x00, 0x00, 0x00, 0x00, 0x00, 0x00, 0x00, 0x00, 0x00, 0x00, 0x00, 0x00, 0x00, 0x00
      };
      display.drawBitmap(0, 0, image_data_Saraarray, 128, 64, 1);
      if (buttonValue == 0) {
        display.clearDisplay();
        mode = 4;
        previousMillis = millis();
      }
    }


    char* text = "Night  ";
    text[6] = score + '0';
    display.setCursor(0, 0);
    display.println(text);
    display.display();

    if (thisNote < 100 && millis() - musicPreviousMillis >= pauseBetweenNotes) {
      musicPreviousMillis = millis();

      int noteDuration = 60 * noteDurations[thisNote] * 2;
      tone(speakerPin, melody[thisNote], noteDuration);


      pauseBetweenNotes = noteDuration * 1.30;
      thisNote = (thisNote + 1) % 54;
    }
  }


  if (mode == 4) {
    noTone(speakerPin);
    static const unsigned char PROGMEM image_data_Saraarray[] = {
      0xff, 0xff, 0xff, 0xff, 0xff, 0xff, 0xff, 0xff, 0xff, 0xff, 0xff, 0xff, 0xff, 0xff, 0xff, 0xff,
      0xff, 0xff, 0xff, 0xff, 0xff, 0xff, 0xff, 0xff, 0xff, 0xff, 0xff, 0xff, 0xff, 0xff, 0xff, 0xff,
      0xff, 0xff, 0xff, 0xff, 0xff, 0xff, 0xff, 0xff, 0xff, 0xff, 0xff, 0xff, 0xff, 0xff, 0xff, 0xff,
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      0xff, 0xff, 0xff, 0xff, 0xff, 0xff, 0xff, 0xff, 0xff, 0xff, 0xff, 0xff, 0xff, 0xff, 0xff, 0xff
    };
    display.drawBitmap(0, 0, image_data_Saraarray, 128, 64, 1);
    display.display();


    if (buttonValue == 0 && millis() - previousMillis >= 500) {

      if (score <= 8) {
        display.clearDisplay();
        mode = 3;
        pop = 0;
        score += 1;
        previousMillis = millis();
      } else {
        display.clearDisplay();
        mode = 6;
        pop = 0;
        score = 1;
        previousMillis = millis();
      }
    }
  }
  if (mode == 5) {
    tone(speakerPin, (2000 - (millis() - previousMillis) * pop));
    display.clearDisplay();
    static const unsigned char PROGMEM image_data_Saraarray[] = {
      0xff, 0xff, 0xff, 0xff, 0xff, 0xff, 0xff, 0xff, 0xff, 0xff, 0xff, 0xff, 0xff, 0xff, 0xff, 0xff,
      0xff, 0xff, 0xff, 0xff, 0xff, 0xff, 0xff, 0xff, 0xff, 0xff, 0xff, 0xff, 0xff, 0xff, 0xff, 0xff,
      0xff, 0xff, 0xff, 0xff, 0xff, 0xff, 0xff, 0xff, 0xff, 0xff, 0xff, 0xff, 0xff, 0xff, 0xff, 0xff,
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      0x0f, 0xff, 0xf7, 0xc0, 0x03, 0x01, 0x00, 0xff, 0xe0, 0x20, 0x03, 0x00, 0x07, 0xff, 0xff, 0x80
    };
    display.drawBitmap(0, 0, image_data_Saraarray, 128, 64, 1);
    display.display();

    if (buttonValue == 0 && millis() - previousMillis >= 500) {
      display.clearDisplay();
      mode = 1;
      score = 1;
      previousMillis = millis();
    }
  }
  if (mode == 6) {
    display.clearDisplay();
    static const unsigned char PROGMEM image_data_Saraarray[] = {
      0xff, 0xff, 0xff, 0xff, 0xff, 0xff, 0xff, 0xff, 0xff, 0xff, 0xff, 0xff, 0xff, 0xff, 0xff, 0xff,
      0xff, 0xff, 0xff, 0xff, 0xff, 0xff, 0xff, 0xff, 0xff, 0xff, 0xff, 0xff, 0xff, 0xff, 0xff, 0xff,
      0xff, 0xff, 0xff, 0xff, 0xff, 0xff, 0xff, 0xff, 0xff, 0xff, 0xff, 0xff, 0xff, 0xff, 0xff, 0xff,
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      0x00, 0x00, 0x00, 0x00, 0x00, 0x00, 0x00, 0x00, 0x00, 0x00, 0x00, 0x00, 0x00, 0x00, 0x00, 0x00
    };
    display.drawBitmap(0, 0, image_data_Saraarray, 128, 64, 1);
    display.display();

    if (buttonValue == 0 && millis() - previousMillis >= 500) {
      display.clearDisplay();
      mode = 1;
      score = 1;
      previousMillis = millis();
    }

    if (millis() - previousMillis <= 1500) {
      tone(speakerPin, (millis() - previousMillis) * 10);
    } else noTone(speakerPin);
  }
}
